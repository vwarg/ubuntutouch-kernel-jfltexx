## arch/arm/configs/jf_eur_defconfig
```kconfig
CONFIG_MACH_JF_EUR=y
CONFIG_EXTRA_FIRMWARE="audience-es325-fw-eur.bin"
CONFIG_EXTRA_FIRMWARE_DIR="firmware"
CONFIG_SYSVIPC=y
CONFIG_NAMESPACES=y
CONFIG_UTS_NS=y
CONFIG_IPC_NS=y
CONFIG_USER_NS=y
CONFIG_PID_NS=y
CONFIG_NET_NS=y
CONFIG_DEVTMPFS=y
CONFIG_DEVTMPFS_MOUNT=y
CONFIG_DEVPTS_MULTIPLE_INSTANCES=y
CONFIG_FSNOTIFY=y
CONFIG_DNOTIFY=y
CONFIG_INOTIFY_USER=y
CONFIG_FANOTIFY=y
CONFIG_FANOTIFY_ACCESS_PERMISSIONS=y
CONFIG_SWAP=y
# CONFIG_ANDROID_PARANOID_NETWORK is not set
CONFIG_VT=y
CONFIG_VT_CONSOLE=y
```

## arch/arm/configs/jfeng_defconfig
```kconfig
CONFIG_LOCALVERSION=""
CONFIG_MSM_RTB=y
CONFIG_MSM_RTB_SEPARATE_CPUS=y
CONFIG_MSM_L2_ERP_PRINT_ACCESS_ERRORS=y
# CONFIG_MSM_L2_ERP_1BIT_PANIC is not set
CONFIG_MSM_CACHE_DUMP=y
CONFIG_MSM_CACHE_DUMP_ON_PANIC=y
CONFIG_USB_MON=y
CONFIG_LOCKUP_DETECTOR=y
CONFIG_DEBUG_KMEMLEAK=y
CONFIG_DEBUG_KMEMLEAK_DEFAULT_OFF=y
CONFIG_DEBUG_SPINLOCK=y
CONFIG_DEBUG_MUTEXES=y
CONFIG_DEBUG_ATOMIC_SLEEP=y
CONFIG_DEBUG_STACK_USAGE=y
CONFIG_DEBUG_LIST=y
CONFIG_BLOCK=y
CONFIG_BLK_DEV_IO_TRACE=y
CONFIG_FAULT_INJECTION=y
CONFIG_FAILSLAB=y
CONFIG_FAIL_PAGE_ALLOC=y
CONFIG_FAULT_INJECTION_DEBUG_FS=y
CONFIG_FAULT_INJECTION_STACKTRACE_FILTER=y
CONFIG_DEBUG_PAGEALLOC=y
CONFIG_SAMSUNG_BATTERY_ENG_TEST=y

# Overriding the rooting prevention feature as disable on ENG build 
# CONFIG_SEC_RESTRICT_ROOTING is not set 
# CONFIG_SEC_RESTRICT_SETUID is not set 
# CONFIG_SEC_RESTRICT_FORK is not set 
# CONFIG_SEC_RESTRICT_ROOTING_LOG is not set 

# Fork hang detection
CONFIG_SEC_FORKHANG_DEBUG=y

CONFIG_MACH_JF_EUR=y
CONFIG_EXTRA_FIRMWARE="audience-es325-fw-eur.bin"
CONFIG_EXTRA_FIRMWARE_DIR="firmware"
CONFIG_SYSVIPC=y
CONFIG_NAMESPACES=y
CONFIG_UTS_NS=y
CONFIG_IPC_NS=y
CONFIG_USER_NS=y
CONFIG_PID_NS=y
CONFIG_NET_NS=y
CONFIG_DEVTMPFS=y
CONFIG_DEVTMPFS_MOUNT=y
CONFIG_DEVPTS_MULTIPLE_INSTANCES=y
CONFIG_FSNOTIFY=y
CONFIG_DNOTIFY=y
CONFIG_INOTIFY_USER=y
CONFIG_FANOTIFY=y
CONFIG_FANOTIFY_ACCESS_PERMISSIONS=y
CONFIG_SWAP=y
# CONFIG_ANDROID_PARANOID_NETWORK is not set
CONFIG_VT=y
CONFIG_VT_CONSOLE=y
```
